## opt/external-packages/ifdnfc/Config.in
```kconfig
config BR2_PACKAGE_IFDNFC
	bool "ifdnfc"
	depends on !BR2_STATIC_LIBS
	depends on BR2_TOOLCHAIN_HAS_THREADS
	depends on BR2_USE_MMU # fork()
	depends on BR2_TOOLCHAIN_GCC_AT_LEAST_4_9 # pcsc-lite
	select BR2_PACKAGE_PCSC_LITE
	select BR2_PACKAGE_LIBNFC
	help
	  PC/SC IFD Handler based on libnfc
```

## opt/external-packages/libcamera/Config.in
```kconfig
config BR2_PACKAGE_LIBCAMERA_ARCH_SUPPORTS
	bool
	default y
	depends on !BR2_m68k

menuconfig BR2_PACKAGE_LIBCAMERA
	bool "libcamera"
	depends on BR2_PACKAGE_LIBCAMERA_ARCH_SUPPORTS
	depends on BR2_INSTALL_LIBSTDCPP
	depends on BR2_TOOLCHAIN_HAS_THREADS
	depends on BR2_TOOLCHAIN_GCC_AT_LEAST_9
	depends on !BR2_STATIC_LIBS
	depends on BR2_USE_WCHAR
	depends on BR2_TOOLCHAIN_HEADERS_AT_LEAST_5_3
	select BR2_PACKAGE_GNUTLS
	select BR2_PACKAGE_LIBYAML
	select BR2_PACKAGE_LIBCAMERA_PIPELINE_UVCVIDEO if !BR2_PACKAGE_LIBCAMERA_HAS_PIPELINE
	help
	  libcamera is a new Linux camera stack that provides a software
	  API and hardware abstraction for cameras. It enables complex
	  hardware image processing operations needed for modern cameras
	  such as the Raspberry Pi Camera Module.

	  This replaces the legacy Raspberry Pi firmware camera stack
	  (used by python-picamera) with a modern, open-source solution.

	  https://libcamera.org/

if BR2_PACKAGE_LIBCAMERA

config BR2_PACKAGE_LIBCAMERA_PYTHON
	bool "python bindings"
	depends on BR2_PACKAGE_PYTHON3
	select BR2_PACKAGE_PYTHON_PYBIND
	help
	  Enable libcamera Python bindings. Required for picamera2.

config BR2_PACKAGE_LIBCAMERA_V4L2
	bool "libcamera v4l2 compatibility layer"
	help
	  libcamera V4L2 compatibility layer for applications using the
	  V4L2 API.

config BR2_PACKAGE_LIBCAMERA_HAS_PIPELINE
	bool

config BR2_PACKAGE_LIBCAMERA_PIPELINE_RPI_VC4
	bool "rpi/vc4 pipeline"
	depends on BR2_arm || BR2_aarch64
	select BR2_PACKAGE_LIBCAMERA_HAS_PIPELINE
	help
	  Pipeline for Raspberry Pi devices using the VideoCore 4 GPU.
	  Enable this for Raspberry Pi Camera Module support.

config BR2_PACKAGE_LIBCAMERA_PIPELINE_SIMPLE
	bool "simple pipeline"
	select BR2_PACKAGE_LIBCAMERA_HAS_PIPELINE
	help
	  Pipeline for simple camera pipelines.

config BR2_PACKAGE_LIBCAMERA_PIPELINE_UVCVIDEO
	bool "uvcvideo pipeline"
	help
	  Pipeline for UVC (USB Video Class) camera devices.

endif # BR2_PACKAGE_LIBCAMERA

comment "libcamera needs a toolchain w/ C++, threads, wchar, dynamic library, gcc >= 9, headers >= 5.3"
	depends on BR2_PACKAGE_LIBCAMERA_ARCH_SUPPORTS
	depends on !BR2_INSTALL_LIBSTDCPP || !BR2_TOOLCHAIN_HAS_THREADS || \
		!BR2_TOOLCHAIN_GCC_AT_LEAST_9 || BR2_STATIC_LIBS || !BR2_USE_WCHAR || \
		!BR2_TOOLCHAIN_HEADERS_AT_LEAST_5_3
```

## opt/external-packages/nfc-bindings/Config.in
```kconfig
config BR2_PACKAGE_NFC_BINDINGS
	bool "nfc_bindings"
	select BR2_PACKAGE_LIBNFC
	select BR2_PACKAGE_LIBUSB
	select BR2_PACKAGE_LIBUSB_COMPAT
	
	help
	  scripting language bindings for libnfc
```

## opt/external-packages/openct/Config.in
```kconfig
config BR2_PACKAGE_OPENCT
	bool "openct"
	depends on !BR2_STATIC_LIBS
	depends on BR2_TOOLCHAIN_HAS_THREADS
	depends on BR2_USE_MMU # fork()
	depends on BR2_TOOLCHAIN_GCC_AT_LEAST_4_9 # pcsc-lite
	select BR2_PACKAGE_PCSC_LITE
	select BR2_PACKAGE_LIBTOOL

	help
	  OpenCT implements drivers for several smart card readers
```

## opt/external-packages/python-ecdsa/Config.in
```kconfig
config BR2_PACKAGE_PYTHON_ECDSA
	bool "python-ecdsa"
	select BR2_PACKAGE_PYTHON_SIX
	help
	  ECDSA cryptographic signature library in Python

	  https://pypi.org/project/ecdsa
```

## opt/external-packages/python-inflate64/Config.in
```kconfig
config BR2_PACKAGE_PYTHON_INFLATE64
bool "python-inflate64"
help
  Deflate64 compression/decompression library

  https://pypi.org/project/inflate64/
```

## opt/external-packages/python-keycard-py/Config.in
```kconfig
config BR2_PACKAGE_PYTHON_KEYCARD_PY
	bool "python-keycard-py"
	select BR2_PACKAGE_PYTHON_ECDSA
	select BR2_PACKAGE_PYTHON_PYAES
	select BR2_PACKAGE_PYTHON_PYSCARD
	help
	  Python API for Java Card and Keycard operations.

	  https://github.com/mmlado/keycard-py
```

## opt/external-packages/python-mnemonic/Config.in
```kconfig
config BR2_PACKAGE_PYTHON_MNEMONIC
	bool "python-mnemonic"
	help
      Mnemonic code for generating deterministic keys, BIP39


	  https://github.com/trezor/python-mnemonic
    
```

## opt/external-packages/python-multivolumefile/Config.in
```kconfig
config BR2_PACKAGE_PYTHON_MULTIVOLUMEFILE
bool "python-multivolumefile"
help
  Multi volume file wrapper library

  https://pypi.org/project/multivolumefile/
```

## opt/external-packages/python-ndeflib/Config.in
```kconfig
config BR2_PACKAGE_PYTHON_NDEFLIB
	bool "python-ndeflib"
	help
	  Python library for parsing and generating NFC Data Exchange Format (NDEF) messages.

	  https://github.com/nfcpy/ndeflib
```

## opt/external-packages/python-picamera2/Config.in
```kconfig
config BR2_PACKAGE_PYTHON_PICAMERA2
	bool "python-picamera2"
	depends on BR2_PACKAGE_PYTHON3
	depends on BR2_PACKAGE_LIBCAMERA
	select BR2_PACKAGE_PYTHON_NUMPY
	select BR2_PACKAGE_LIBCAMERA_PYTHON
	help
	  Picamera2 is the libcamera-based replacement for Picamera.
	  It provides an easy-to-use Python API for Raspberry Pi cameras
	  using the modern libcamera camera stack.

	  https://github.com/raspberrypi/picamera2
```

## opt/external-packages/python-py7zr/Config.in
```kconfig
config BR2_PACKAGE_PYTHON_PY7ZR
bool "python-py7zr"
select BR2_PACKAGE_PYTHON_TEXTTABLE
select BR2_PACKAGE_PYTHON_PYCRYPTODOMEX
select BR2_PACKAGE_PYTHON_BROTLI
select BR2_PACKAGE_PYTHON_PSUTIL
select BR2_PACKAGE_PYTHON_PYZSTD
select BR2_PACKAGE_PYTHON_PYPPMD
select BR2_PACKAGE_PYTHON_PYBCJ
select BR2_PACKAGE_PYTHON_MULTIVOLUMEFILE
select BR2_PACKAGE_PYTHON_INFLATE64
help
  Pure python 7-zip library

  https://pypi.org/project/py7zr/
```

## opt/external-packages/python-pybcj/Config.in
```kconfig
config BR2_PACKAGE_PYTHON_PYBCJ
bool "python-pybcj"
help
  BCJ filter library

  https://pypi.org/project/pybcj/
```

## opt/external-packages/python-pygp/Config.in
```kconfig
config BR2_PACKAGE_PYTHON_PYGP
	bool "python-pygp"
	help
      Python API for GlobalPlatform smartcard communication

	  https://github.com/3rdIteration/PyGP
    
```

## opt/external-packages/python-pyppmd/Config.in
```kconfig
config BR2_PACKAGE_PYTHON_PYPPMD
bool "python-pyppmd"
help
  PPMd compression/decompression library

  https://pypi.org/project/pyppmd/
```

## opt/external-packages/python-pysatochip/Config.in
```kconfig
config BR2_PACKAGE_PYTHON_PYSATOCHIP
	bool "python-pysatochip"
	help
      Python API for Satochip Devices (Seedkeeper, Satochip and Satodime)

	  https://github.com/3rdIteration/pysatochip
    
```

## opt/external-packages/python-pyscard/Config.in
```kconfig
config BR2_PACKAGE_PYTHON_PYSCARD
	bool "python-pyscard"
	help
      pyscard smartcard library for python


	  https://github.com/LudovicRousseau/pyscard
    
```

## opt/external-packages/python-pyzstd/Config.in
```kconfig
config BR2_PACKAGE_PYTHON_PYZSTD
bool "python-pyzstd"
select BR2_PACKAGE_PYTHON_TYPING_EXTENSIONS
help
  Python bindings to Zstandard (zstd) compression library.

  https://pypi.org/project/pyzstd/
```

## opt/external-packages/python-shamir-mnemonic/Config.in
```kconfig
config BR2_PACKAGE_PYTHON_SHAMIR_MNEMONIC
        bool "python-shamir-mnemonic"
        help
          SLIP-0039 Shamir's Secret-Sharing for mnemonic phrases

          https://github.com/3rdIteration/python-shamir-mnemonic
```

## opt/external-packages/python-specter-card/Config.in
```kconfig
config BR2_PACKAGE_PYTHON_SPECTER_CARD
	bool "python-specter-card"
	select BR2_PACKAGE_PYTHON_CRYPTOGRAPHY
	select BR2_PACKAGE_PYTHON_PYSCARD
	help
	  Python library and CLI for Specter JavaCard applets.

	  https://github.com/3rdIteration/specter-javacard
```

## opt/external-packages/python-swig-pypi/Config.in.host
```kconfig
config BR2_PACKAGE_HOST_PYTHON_SWIG_PYPI
bool "host python-swig (prebuilt)"
help
  Install the SWIG tool from the swig-pypi project on PyPI for host builds.
```

## opt/external-packages/python-tomli/Config.in
```kconfig
config BR2_PACKAGE_PYTHON_TOMLI
    bool "python-tomli"
    help
      A fast TOML parser.

      https://github.com/hukkinj1/tomli
```

## opt/pi2-smartcard-dev/Config.in
```kconfig
source "../external-packages/python-urtypes/Config.in"
source "../external-packages/python-pyzbar/Config.in"
source "../external-packages/python-mock/Config.in"
source "../external-packages/python-embit/Config.in"
source "../external-packages/python-picamera/Config.in"
source "../external-packages/python-pysatochip/Config.in"
source "../external-packages/python-smbus2/Config.in"
source "../external-packages/python-pyscard/Config.in"
source "../external-packages/python-mnemonic/Config.in"
source "../external-packages/python-shamir-mnemonic/Config.in"
source "../external-packages/python-pillow-ep/Config.in"
source "../external-packages/libraqm/Config.in"
source "../external-packages/ifdnfc/Config.in"
source "../external-packages/openct/Config.in"
source "../external-packages/nfc-bindings/Config.in"
source "../external-packages/ccid-sec1210/Config.in"
source "../external-packages/python-pgpy/Config.in"
source "../external-packages/python-pyzstd/Config.in"
source "../external-packages/python-pyppmd/Config.in"
source "../external-packages/python-pybcj/Config.in"
source "../external-packages/python-multivolumefile/Config.in"
source "../external-packages/python-inflate64/Config.in"
source "../external-packages/python-py7zr/Config.in"
```

## opt/pi2-smartcard-dev/configs/pi2-smartcard-dev_defconfig
```kconfig
BR2_arm=y
BR2_cortex_a7=y
BR2_ARM_EABIHF=y
BR2_ARM_FPU_NEON_VFPV4=y

BR2_DL_DIR="$(TOPDIR)/../../buildroot_dl"
BR2_CCACHE=y
BR2_REPRODUCIBLE=y
BR2_TOOLCHAIN_BUILDROOT_VENDOR="Buildroot"
BR2_TOOLCHAIN_BUILDROOT_GLIBC=y
BR2_PACKAGE_HOST_LINUX_HEADERS_CUSTOM_5_15=y
BR2_PACKAGE_GLIBC_UTILS=y
BR2_TOOLCHAIN_BUILDROOT_CXX=y
BR2_TARGET_GENERIC_HOSTNAME="seedsigner-os"
BR2_ROOTFS_DEVICE_CREATION_DYNAMIC_MDEV=y
BR2_TARGET_GENERIC_ROOT_PASSWD="passworDT"
BR2_ROOTFS_OVERLAY="../rootfs-overlay/"
BR2_ROOTFS_POST_BUILD_SCRIPT="../pi2-smartcard-dev/board/post-build.sh"
BR2_ROOTFS_POST_IMAGE_SCRIPT="../pi2-smartcard-dev/board/post-image-seedsigner.sh"
BR2_LINUX_KERNEL=y
BR2_LINUX_KERNEL_CUSTOM_TARBALL=y
BR2_LINUX_KERNEL_CUSTOM_TARBALL_LOCATION="$(call github,raspberrypi,linux,14b35093ca68bf2c81bbc90aace5007142b40b40)/linux-14b35093ca68bf2c81bbc90aace5007142b40b40.tar.gz"
BR2_LINUX_KERNEL_NEEDS_HOST_OPENSSL=y
BR2_LINUX_KERNEL_USE_CUSTOM_CONFIG=y
BR2_LINUX_KERNEL_CUSTOM_CONFIG_FILE="../pi2-smartcard-dev/board/kernel.config"
BR2_LINUX_KERNEL_GZIP=y
BR2_LINUX_KERNEL_DTS_SUPPORT=y
BR2_LINUX_KERNEL_INTREE_DTS_NAME="bcm2709-rpi-2-b"
BR2_PACKAGE_BUSYBOX_CONFIG="../pi2-smartcard-dev/board/busybox.config"
BR2_PACKAGE_BUSYBOX_SHOW_OTHERS=y
BR2_PACKAGE_RPI_FIRMWARE=y
BR2_PACKAGE_RPI_FIRMWARE_BOOTCODE_BIN=y
BR2_PACKAGE_RPI_FIRMWARE_VARIANT_PI_X=y
BR2_PACKAGE_RPI_FIRMWARE_CONFIG_FILE="../pi2-smartcard-dev/board/boot_config.txt"
BR2_PACKAGE_RPI_FIRMWARE_CMDLINE_FILE="../pi2-smartcard-dev/board/boot_cmdline.txt"
BR2_PACKAGE_RPI_USERLAND=y
BR2_PACKAGE_LINUX_FIRMWARE=y
BR2_PACKAGE_LINUX_FIRMWARE_BRCM_BCM43XX=y
BR2_PACKAGE_SPI_TOOLS=y
BR2_PACKAGE_UHUBCTL=y
BR2_PACKAGE_PYTHON3=y
BR2_PACKAGE_PYTHON_ECDSA=y
BR2_PACKAGE_PYTHON_PIGPIO=y
BR2_PACKAGE_PYTHON_PILLOW=y
BR2_PACKAGE_PYTHON_PYAES=y
BR2_PACKAGE_PYTHON_PYQRCODE=y
BR2_PACKAGE_PYTHON_RPI_GPIO=y
BR2_PACKAGE_PYTHON_SPIDEV=y
BR2_PACKAGE_FREETYPE=y
BR2_PACKAGE_LIBQRENCODE=y
BR2_PACKAGE_LIBQRENCODE_TOOLS=y
BR2_PACKAGE_PYTHON_NUMPY=y
BR2_PACKAGE_ZBAR=y
BR2_PACKAGE_BCM2835=y
BR2_PACKAGE_CCID=y
# BR2_PACKAGE_LIBNFC_ARYGON is not set
BR2_PACKAGE_LIBNFC_PN532_I2C=y
# BR2_PACKAGE_LIBNFC_PN53X_USB is not set
BR2_TARGET_ROOTFS_CPIO_GZIP=y
BR2_TARGET_ROOTFS_INITRAMFS=y
BR2_PACKAGE_HOST_DOSFSTOOLS=y
BR2_PACKAGE_HOST_E2FSPROGS=y
BR2_PACKAGE_HOST_GENIMAGE=y
BR2_PACKAGE_HOST_MTOOLS=y
BR2_PACKAGE_HOST_SWIG=y
BR2_PACKAGE_PYTHON_URTYPES=y
BR2_PACKAGE_PYTHON_PYZBAR=y
BR2_PACKAGE_PYTHON_MOCK=y
BR2_PACKAGE_PYTHON_EMBIT=y
BR2_PACKAGE_PYTHON_PICAMERA=y
BR2_PACKAGE_PYTHON_QRCODE=y
BR2_PACKAGE_PYTHON_PYSATOCHIP=y
BR2_PACKAGE_PYTHON_PYSCARD=y
BR2_PACKAGE_PYTHON_SMBUS2=y
BR2_PACKAGE_PYTHON_MNEMONIC=y
BR2_PACKAGE_PYTHON_SHAMIR_MNEMONIC=y
BR2_PACKAGE_PYTHON_PGPY=y
BR2_PACKAGE_PYTHON_PYASN1=y
BR2_PACKAGE_IFDNFC=y
BR2_PACKAGE_OPENCT=y
BR2_PACKAGE_NFC_BINDINGS=y
BR2_PACKAGE_PYTHON_PYCRYPTODOMEX=y
BR2_PACKAGE_GNUPG2=y
BR2_PACKAGE_CCID_SEC1210=y
BR2_PACKAGE_RNG_TOOLS=y
BR2_PACKAGE_DROPBEAR=y
BR2_PACKAGE_RSYNC=y
BR2_PACKAGE_GIT=y
BR2_PACKAGE_LIBCURL=y
BR2_PACKAGE_LIBCURL_MBEDTLS=y
BR2_PACKAGE_LIBCURL_HTTP2=y
BR2_PACKAGE_NGHTTP2=y
BR2_PACKAGE_CA_CERTIFICATES=y
BR2_PACKAGE_WPA_SUPPLICANT=y
BR2_PACKAGE_IW=y
BR2_PACKAGE_WIRELESS_TOOLS=y
BR2_PACKAGE_WIRELESS_REGDB=y
BR2_SYSTEM_DHCP="eth0 wlan0"
BR2_PACKAGE_BZIP2=y
BR2_PACKAGE_PYTHON3_SSL=y
BR2_PACKAGE_PYTHON3_BZIP2
```

## opt/pi4-smartcard/Config.in
```kconfig
source "../external-packages/python-urtypes/Config.in"
source "../external-packages/python-pyzbar/Config.in"
source "../external-packages/python-mock/Config.in"
source "../external-packages/python-embit/Config.in"
source "../external-packages/python-picamera/Config.in"
source "../external-packages/python-pysatochip/Config.in"
source "../external-packages/python-pyscard/Config.in"
source "../external-packages/python-mnemonic/Config.in"
source "../external-packages/python-pillow-9_4/Config.in"
source "../external-packages/ifdnfc/Config.in"
source "../external-packages/openct/Config.in"
source "../external-packages/nfc-bindings/Config.in"
```
