## opt/external-packages/python-pygame-ce/Config.in
```kconfig
config BR2_PACKAGE_PYTHON_PYGAME_CE
	bool "python-pygame-ce"
	depends on !BR2_STATIC_LIBS # sdl2
	select BR2_PACKAGE_SDL2 # runtime
	select BR2_PACKAGE_SDL2_IMAGE # runtime
	select BR2_PACKAGE_SDL2_MIXER # runtime
	select BR2_PACKAGE_SDL2_TTF # runtime
	select BR2_PACKAGE_FREETYPE # runtime
	help
	  Community Edition of pygame, a python library for multimedia
	  and game development. SeedSigner's x86_64 desktop profile uses
	  it for the on-screen display driver and for keyboard/mouse
	  input when no GPIO hardware is present.

	  https://pyga.me
```

## opt/external-packages/python-wallycore/Config.in
```kconfig
config BR2_PACKAGE_PYTHON_WALLYCORE
	bool "python-wallycore"
	help
	  Python bindings for libwally-core, Blockstream's Bitcoin
	  wallet library (with its bundled libsecp256k1-zkp).

	  SeedSigner uses it as an independent second implementation
	  that cross-checks embit: seeds, descriptors, addresses, psbt
	  parsing and every signature (src/seedsigner/crosscheck).
	  The app refuses to sign on device without it.

	  https://github.com/ElementsProject/libwally-core
```
